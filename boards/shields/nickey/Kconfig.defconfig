## boards/shields/nickey/Kconfig.defconfig
```kconfig
if SHIELD_NICKEY_R

config ZMK_KEYBOARD_NAME
    default "nickey"

config ZMK_BLE
    default y

config ZMK_SPLIT_ROLE_CENTRAL
    default y

config INPUT
    default y

config ZMK_POINTING
    default y

config SPI
    default y

endif

if SHIELD_NICKEY_R || SHIELD_NICKEY_L

config NFCT_PINS_AS_GPIOS
    default y

config ZMK_SPLIT
    default y

config RGBLED_WIDGET_BATTERY_LEVEL_HIGH
    default 30

config RGBLED_WIDGET_BATTERY_LEVEL_CRITICAL
    default 10

config I2C
    default y

config LPPS
    default y

endif
```

## boards/shields/nickey/Kconfig.shield
```kconfig
config SHIELD_NICKEY_R
    def_bool $(shields_list_contains,nickey_r)

config SHIELD_NICKEY_L
    def_bool $(shields_list_contains,nickey_l)
```

## boards/shields/tweakbit/Kconfig.defconfig
```kconfig
if SHIELD_TWEAKBIT_R

config ZMK_KEYBOARD_NAME
    default "tweakbit"

config ZMK_BLE
    default y

config ZMK_SPLIT_ROLE_CENTRAL
    default y

endif

if SHIELD_TWEAKBIT_R || SHIELD_TWEAKBIT_L

config NFCT_PINS_AS_GPIOS
    default y

config ZMK_SPLIT
    default y

config INPUT
    default y

config ZMK_POINTING
    default y

config SPI
    default y

config PMW3610
    default y

config PMW3610_SWAP_XY
    default y

config RGBLED_WIDGET_BATTERY_LEVEL_HIGH
    default 30

config RGBLED_WIDGET_BATTERY_LEVEL_CRITICAL
    default 10

endif
```

## boards/shields/tweakbit/Kconfig.shield
```kconfig
config SHIELD_TWEAKBIT_R
    def_bool $(shields_list_contains,tweakbit_r)

config SHIELD_TWEAKBIT_L
    def_bool $(shields_list_contains,tweakbit_l)
```
